## Kconfig.defconfig
```kconfig
if SHIELD_PHENDRANA_LEFT

config ZMK_KEYBOARD_NAME
    default "Phendrana"

config ZMK_SPLIT_ROLE_CENTRAL
    default y

endif

if SHIELD_PHENDRANA_LEFT || SHIELD_PHENDRANA_RIGHT

config ZMK_SPLIT
    default y

if ZMK_BACKLIGHT

config PWM
    default y

config LED_PWM
    default y

endif # ZMK_BACKLIGHT

endif
```

## Kconfig.shield
```kconfig
config SHIELD_PHENDRANA_LEFT
    def_bool $(shields_list_contains,phendrana_left)

config SHIELD_PHENDRANA_RIGHT
    def_bool $(shields_list_contains,phendrana_right)
```
